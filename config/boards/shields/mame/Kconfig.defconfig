## config/boards/shields/mame/Kconfig.defconfig
```kconfig
if MAME_LEFT

config ZMK_KEYBOARD_NAME
    default "Mame Keyboard"

config ZMK_SPLIT_ROLE_CENTRAL
    default y

endif

if MAME_LEFT || MAME_RIGHT

config ZMK_SPLIT
    default y

endif
```

## config/boards/shields/mame/Kconfig.shield
```kconfig
config MAME_LEFT
    def_bool $(shields_list_contains,mame_left)
config MAME_RIGHT
    def_bool $(shields_list_contains,mame_right)
```
